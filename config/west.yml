## config/west.yml
```yaml
manifest:
  version: "0.10"
  remotes:
    - name: zmkfw
      url-base: https://github.com/zmkfirmware
      fetch: zmk.git
  defaults:
    remote: zmkfw
    revision: main
  projects:
    - name: app
      path: app
      revision: main
```
